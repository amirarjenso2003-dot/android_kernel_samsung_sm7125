## arch/arm64/configs/vendor/lineage-a52q-custom_defconfig
```kconfig
# Defconfig untuk Samsung Galaxy A52 (SM7125) - LineageOS 23.0 (Android 16)
# KitsuneDnm OC GPU Kernel Custom
# Dioptimalkan untuk performa dan stabilitas

CONFIG_LOCALVERSION="-KitsuneDnm_oc_gpu_700"
CONFIG_LOCALVERSION_AUTO=n

# ============================================
# KERNEL ARCHITECTURE & BASIC SETTINGS
# ============================================
CONFIG_ARCH_QCOM=y
CONFIG_ARCH_SM7125=y
CONFIG_ARM64=y
CONFIG_ARM64_VA_BITS=39
CONFIG_ARM64_PA_BITS=48
CONFIG_SMP=y
CONFIG_NR_CPUS=8
CONFIG_PREEMPT=y
CONFIG_PREEMPT_RCU=y

# ============================================
# DEVICE SPECIFIC (Samsung A52)
# ============================================
CONFIG_MACH_SAMSUNG_SM7125=y
CONFIG_MACH_SAMSUNG_A52Q=y

# ============================================
# CPU FREQUENCY SCALING & PERFORMANCE
# ============================================
CONFIG_CPU_FREQ=y
CONFIG_CPU_FREQ_STAT=y
CONFIG_CPU_FREQ_STAT_DETAILS=y
CONFIG_CPU_FREQ_DEFAULT_GOV_SCHEDUTIL=y
CONFIG_CPU_FREQ_GOV_POWERSAVE=y
CONFIG_CPU_FREQ_GOV_USERSPACE=y
CONFIG_CPU_FREQ_GOV_ONDEMAND=y
CONFIG_CPU_FREQ_GOV_CONSERVATIVE=y
CONFIG_CPU_FREQ_GOV_SCHEDUTIL=y
CONFIG_CPUFREQ_DT=y
CONFIG_QCOM_CPUFREQ_HW=y

# ============================================
# GPU (ADRENO) - OC OPTIMIZATION
# ============================================
CONFIG_MSM_ADRENO=y
CONFIG_QCOM_ADRENO_DEFAULT_CLOCK=y
CONFIG_ADRENO_IDLER=y
CONFIG_DEVFREQ_GOV_SIMPLE_ONDEMAND=y
CONFIG_DEVFREQ_GOV_PERFORMANCE=y
CONFIG_DEVFREQ_GOV_POWERSAVE=y
CONFIG_DEVFREQ_SIMPLE_DEV=y

# Adreno GPU CLOCK Levels untuk OC
# Max: 710 MHz (dari default ~650 MHz)
CONFIG_ADRENO_IDLER=y

# ============================================
# CPUFREQ SCALING & GOVERNORS
# ============================================
CONFIG_SCHED_WALT=y
CONFIG_SCHED_TUNE=y
CONFIG_SCHEDUTIL_CGROUP_SCHED=y
CONFIG_SCHEDTUNE_PREFER_IDLE=y
CONFIG_SCHED_MC=y
CONFIG_SCHED_SMT=y

# ============================================
# THERMAL MANAGEMENT
# ============================================
CONFIG_THERMAL=y
CONFIG_THERMAL_STATISTICS=y
CONFIG_THERMAL_WRITABLE_TRIPS=y
CONFIG_THERMAL_DEFAULT_GOVERNOR="step_wise"
CONFIG_THERMAL_GOV_FAIR_SHARE=y
CONFIG_THERMAL_GOV_STEP_WISE=y
CONFIG_THERMAL_GOV_USER_SPACE=y
CONFIG_CPU_THERMAL=y
CONFIG_GPU_THERMAL=y

# ============================================
# MEMORY & PAGE CACHE
# ============================================
CONFIG_MEMORY_HOTPLUG=y
CONFIG_MEMORY_HOTREMOVE=y
CONFIG_SWAP=y
CONFIG_ZSWAP=y
CONFIG_ZPOOL=y
CONFIG_ZBUD=y
CONFIG_Z3FOLD=y
CONFIG_ZSMALLOC=y
CONFIG_CMA=y
CONFIG_CMA_SIZE_MBYTES=64
CONFIG_DMA_CMA=y

# ============================================
# STORAGE & FILE SYSTEM
# ============================================
CONFIG_EXT4_FS=y
CONFIG_EXT4_FS_POSIX_ACL=y
CONFIG_EXT4_FS_SECURITY=y
CONFIG_F2FS_FS=y
CONFIG_F2FS_FS_POSIX_ACL=y
CONFIG_F2FS_FS_SECURITY=y
CONFIG_TMPFS=y
CONFIG_TMPFS_POSIX_ACL=y

# I/O Scheduler
CONFIG_CFQ_GROUP_IOSCHEDULING=y
CONFIG_IOSCHED_CFQ=y
CONFIG_CFQ_GROUP_IOSCHEDULING=y
CONFIG_BLK_CGROUP=y

# ============================================
# NETWORKING
# ============================================
CONFIG_NET=y
CONFIG_PACKET=y
CONFIG_UNIX=y
CONFIG_INET=y
CONFIG_IP_PNP=y
CONFIG_IPV6=y
CONFIG_NETFILTER=y
CONFIG_NF_CONNTRACK=y
CONFIG_NF_CONNTRACK_EVENTS=y
CONFIG_NETFILTER_XT_MATCH_CONNTRACK=y
CONFIG_IPTABLES_NAT=y
CONFIG_NF_NAT=y

# ============================================
# WIRELESS & CONNECTIVITY
# ============================================
CONFIG_CFG80211=y
CONFIG_CFG80211_DEBUGFS=y
CONFIG_MAC80211=y
CONFIG_RFKILL=y
CONFIG_RFKILL_PM=y

# ============================================
# USB & SERIAL
# ============================================
CONFIG_USB=y
CONFIG_USB_ANNOUNCE_NEW_DEVICES=y
CONFIG_USB_XHCI_HCD=y
CONFIG_USB_XHCI_PLATFORM=y
CONFIG_USB_EHCI_HCD=y
CONFIG_USB_EHCI_ROOT_HUB_TT=y
CONFIG_USB_EHCI_TT_NEWSCHED=y
CONFIG_USB_STORAGE=y
CONFIG_USB_UAS=y
CONFIG_USB_MON=y

# Serial
CONFIG_SERIAL_8250=y
CONFIG_SERIAL_8250_CONSOLE=y
CONFIG_SERIAL_CORE=y
CONFIG_SERIAL_CORE_CONSOLE=y

# ============================================
# DISPLAY & GRAPHICS
# ============================================
CONFIG_DRM=y
CONFIG_DRM_FBDEV_EMULATION=y
CONFIG_DRM_LOAD_EDID_FIRMWARE=y
CONFIG_BACKLIGHT_CLASS_DEVICE=y
CONFIG_LCD_CLASS_DEVICE=y

# ============================================
# INPUT DEVICES
# ============================================
CONFIG_INPUT=y
CONFIG_INPUT_EVDEV=y
CONFIG_INPUT_KEYBOARD=y
CONFIG_INPUT_MOUSE=y
CONFIG_INPUT_MOUSEDEV=y
CONFIG_INPUT_TOUCHSCREEN=y

# ============================================
# SENSORS & ACCELEROMETER
# ============================================
CONFIG_IIO=y
CONFIG_IIO_BUFFER=y
CONFIG_IIO_TRIGGERED_BUFFER=y
CONFIG_IIO_SYSFS_TRIGGER=y

# ============================================
# POWER MANAGEMENT
# ============================================
CONFIG_PM=y
CONFIG_PM_DEBUG=y
CONFIG_PM_SLEEP=y
CONFIG_SUSPEND=y
CONFIG_HIBERNATION=y
CONFIG_PM_STD_PARTITION=""
CONFIG_PM_WAKELOCKS=y
CONFIG_PM_WAKELOCKS_LIMIT=0
CONFIG_PM_AUTOSLEEP=y

# CPU Idle
CONFIG_CPU_IDLE=y
CONFIG_CPU_IDLE_MULTIPLE_DRIVERS=y
CONFIG_CPU_IDLE_GOV_LADDER=y
CONFIG_CPU_IDLE_GOV_MENU=y

# ============================================
# SOUND & AUDIO
# ============================================
CONFIG_SOUND=y
CONFIG_SND=y
CONFIG_SND_HWDEP=y
CONFIG_SND_RAWMIDI=y
CONFIG_SND_TIMER=y
CONFIG_SND_PCM=y
CONFIG_SND_JACK=y
CONFIG_SND_JACK_INPUT_POLLRATE=20
CONFIG_SND_SOC=y
CONFIG_SND_SOC_COMPRESS=y

# ============================================
# SECURITY
# ============================================
CONFIG_SECURITY=y
CONFIG_SECURITY_SELINUX=y
CONFIG_SECURITY_SELINUX_BOOTPARAM=y
CONFIG_SECURITY_APPARMOR=y
CONFIG_KEYS=y
CONFIG_PERSISTENT_KEYRINGS=y
CONFIG_KEY_DH_OPERATIONS=y

# ============================================
# DEBUGGING & LOGGING
# ============================================
CONFIG_DEBUG_INFO=y
CONFIG_DEBUG_INFO_DWARF4=y
CONFIG_DEBUG_KERNEL=y
CONFIG_DYNAMIC_DEBUG=y
CONFIG_KGDB=y
CONFIG_KGDB_SERIAL_CONSOLE=y
CONFIG_KGDB_KDB=y
CONFIG_DEBUG_SLAB=y
CONFIG_DEBUG_PAGEALLOC=y
CONFIG_DEBUG_SPINLOCK=y
CONFIG_DEBUG_SPINLOCK_SLEEP=y
CONFIG_SCHEDSTATS=y
CONFIG_TIMER_STATS=y

# ============================================
# MODULES & LOADABLE KERNEL CODE
# ============================================
CONFIG_MODULES=y
CONFIG_MODULE_UNLOAD=y
CONFIG_MODULE_FORCE_UNLOAD=y
CONFIG_MODVERSIONS=y
CONFIG_MODULE_SRCVERSION_ALL=y

# ============================================
# CGROUPS & NAMESPACES
# ============================================
CONFIG_CGROUPS=y
CONFIG_CGROUP_DEVICE=y
CONFIG_CGROUP_CPUACCT=y
CONFIG_CGROUP_FREEZER=y
CONFIG_CGROUP_NETCLS=y
CONFIG_CGROUP_PERF=y
CONFIG_CGROUP_PIDS=y
CONFIG_MEMCG=y
CONFIG_MEMCG_SWAP=y
CONFIG_BLK_CGROUP=y
CONFIG_CONTAINER_JUMPKEY=y

# ============================================
# VIRTUALIZATION (Optional)
# ============================================
CONFIG_VIRTUALIZATION=y
CONFIG_KVM=y
CONFIG_KVM_ARM_HOST=y
CONFIG_KVM_ARM_PMU=y

# ============================================
# PROFILING & TRACING
# ============================================
CONFIG_FTRACE=y
CONFIG_FUNCTION_TRACER=y
CONFIG_FUNCTION_GRAPH_TRACER=y
CONFIG_IRQSOFF_TRACER=y
CONFIG_PREEMPT_TRACER=y
CONFIG_SCHED_TRACER=y
CONFIG_TRACEPOINT_BENCHMARK=y
CONFIG_TRACE_EVAL_MAP_SORT=y

# ============================================
# RCU & SYNCHRONIZATION
# ============================================
CONFIG_RCU_CPU_STALL_DETECTOR=y
CONFIG_RCU_TRACE=y
CONFIG_RCU_BOOST=y
CONFIG_RCU_EQS_DEBUG=y

# ============================================
# MISC FEATURES
# ============================================
CONFIG_HAVE_KERNEL_BZIP2=y
CONFIG_HAVE_KERNEL_GZIP=y
CONFIG_HAVE_KERNEL_XZ=y
CONFIG_HAVE_KERNEL_LZO=y
CONFIG_HAVE_KERNEL_LZ4=y
CONFIG_KERNEL_GZIP=y
CONFIG_HAVE_KERNEL_UNCOMPRESSED=y

# ============================================
# BUILD OPTIONS
# ============================================
CONFIG_IKCONFIG=y
CONFIG_IKCONFIG_PROC=y
CONFIG_LOG_CPU_MAX_BUF_SHIFT=12
CONFIG_PRINTK_TIME=y
CONFIG_PRINTK_CALLER=y
CONFIG_HAVE_DEBUG_KMEMLEAK=y
CONFIG_DEBUG_KMEMLEAK=y
CONFIG_DEBUG_OBJECTS=y
CONFIG_DEBUG_OBJECTS_SELFTEST=y
CONFIG_DEBUG_OBJECTS_ENABLE_CHECK=y
CONFIG_SLUB_DEBUG_ON=y
CONFIG_SLUB_STATS=y

# ============================================
# PERFORMANCE OPTIMIZATION
# ============================================
CONFIG_CC_OPTIMIZE_FOR_PERFORMANCE=y
# CONFIG_CC_OPTIMIZE_FOR_SIZE is not set
CONFIG_OPTIMIZE_INLINING=y

# ============================================
# PANIC & REBOOT OPTIONS
# ============================================
CONFIG_PANIC_ON_OOPS=y
CONFIG_PANIC_ON_OOPS_VALUE=1
CONFIG_PANIC_TIMEOUT=10
CONFIG_REBOOT_ON_PANIC=y

# Ini adalah defconfig dasar untuk Samsung A52 / SM7125 dengan LineageOS 23.0
# Sesuaikan sesuai kebutuhan Anda untuk optimasi lebih lanjut
```
